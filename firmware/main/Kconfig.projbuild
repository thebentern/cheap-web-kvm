## firmware/main/Kconfig.projbuild
```kconfig
# SPDX-License-Identifier: GPL-3.0-or-later

menu "cheap-web-kvm"

    config KVM_LED_ENABLED
        bool "Onboard RGB status LED"
        default y
        help
            Show USB target readiness, Bluetooth pairing, input activity and
            dropped input on a WS2812-compatible onboard RGB LED. LED failures
            do not stop keyboard or mouse operation.

    config KVM_LED_GPIO
        int "RGB LED GPIO"
        depends on KVM_LED_ENABLED
        range 0 48
        default 48
        help
            ESP32-S3-DevKitC-1 v1.0 uses GPIO48; v1.1 uses GPIO38. Check clone
            board wiring before changing this pin. Do not use the USB pins
            GPIO19/20, UART0 protocol pins or UART1 console pins.

    config KVM_LED_BRIGHTNESS
        int "RGB LED maximum brightness (percent)"
        depends on KVM_LED_ENABLED
        range 1 100
        default 10
        help
            Maximum channel level as a percentage of full output. The steady
            ready indicator uses half this level. The default is intentionally
            dim for use beside a monitor.

    config KVM_BLE_ENABLED
        bool "Bluetooth LE transport"
        depends on BT_NIMBLE_ENABLED
        default y
        help
            Accept CH9329 frames over a Bluetooth LE GATT service as well as
            UART0, for hosts with no USB serial such as iPads. Writes need a
            bonded, authenticated link (see KVM_BLE_PASSKEY).

    config KVM_BLE_PASSKEY
        int "Default Bluetooth pairing passkey"
        depends on KVM_BLE_ENABLED
        range 0 999999
        default 123456
        help
            Six-digit passkey a host enters when it first pairs, until one is
            set from the web UI (Settings, Advanced), which saves it in NVS and
            takes precedence. Anyone who knows the passkey in use and is in
            radio range can pair and type into the target. Leading zeros are
            allowed: 4321 is entered as 004321.

    config KVM_MEDIA_LOCAL_PROOF
        bool "Read-only embedded image for local USB boot proof"
        default n
        help
            Embed firmware/local-proof.img (maximum 512 KiB). This is a
            separate bring-up build; it never replaces the client backend.
            Supply your own small bootable UEFI image and verify its license.

    config KVM_MEDIA_WIFI
        bool "Wi-Fi configuration and experimental client-backed media"
        depends on !KVM_MEDIA_LOCAL_PROOF
        default y
        select HTTPD_WS_SUPPORT
        help
            Configure hotspot, router-client mode or Wi-Fi off from the web UI
            over serial or bonded Bluetooth. Settings persist in NVS. Client
            mode can keep a recovery hotspot. Blank build credentials start
            with Wi-Fi off; the browser can enable it without recompiling.

    config KVM_MEDIA_SSID
        string "Initial hotspot SSID (blank generates a device-specific name)"
        depends on KVM_MEDIA_WIFI
        default ""

    config KVM_DEVICE_WEB
        bool "Host the console on the ESP32 over HTTPS"
        depends on KVM_MEDIA_WIFI
        default y
        select MBEDTLS_PEM_WRITE_C
        select ESP_HTTPS_SERVER_ENABLE
        help
            Bundle the generated core web UI in flash. HTTP provides certificate
            setup; HTTPS serves the console and paired browser media sessions.
            Generate the web UI with NUXT_APP_BASE_URL=/ before building firmware.

    config KVM_MEDIA_PASSWORD
        string "Media AP WPA2 password (8-63 characters)"
        depends on KVM_MEDIA_WIFI
        default ""

    config KVM_MEDIA_TOKEN
        string "Media helper token (16-80 characters)"
        depends on KVM_MEDIA_WIFI
        default ""

    config KVM_UART_BAUD
        int "UART0 baud rate (benchmark before changing)"
        range 115200 2000000
        default 921600

endmenu
```
